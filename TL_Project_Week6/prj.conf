## prj.conf
```kconfig
# Logger module
CONFIG_LOG=y

# Button and LED library   
CONFIG_DK_LIBRARY=y

# ADC library
CONFIG_ADC=y

# math.h, pow and sqrt functions
CONFIG_NEWLIB_LIBC=y

# enabloi floattien printtaamisen printk funktiolla tms
CONFIG_CBPRINTF_FP_SUPPORT=y
```

## src/main.c
```c
/*
 * Copyright (c) 2020 Libre Solar Technologies GmbH
 *
 * SPDX-License-Identifier: Apache-2.0
 */
#include <zephyr/logging/log.h>
#include <dk_buttons_and_leds.h>
#include <inttypes.h>
#include <stddef.h>
#include <stdint.h>
#include <zephyr/kernel.h>
#include <zephyr/sys/printk.h>
#include <zephyr/sys/util.h>
#include "adc.h"
#include <zephyr/device.h>
#include <zephyr/devicetree.h>

#include "confusion.h"



#define USER_LED1         	 	DK_LED1
#define USER_LED2          		DK_LED2
#define USER_LED3               DK_LED3
#define USER_LED4               DK_LED4

#define USER_BUTTON_1           DK_BTN1_MSK
#define USER_BUTTON_2           DK_BTN2_MSK
#define USER_BUTTON_3           DK_BTN3_MSK
#define USER_BUTTON_4           DK_BTN4_MSK

#define DEBUG 0  // 0 = changes direction when button 3 is pressed
                 // 1 = fake 100 measurements done to each 6 directions when 3 pressed.
static int direction = -1;	// 0 = x direction high
							// 1 = x directon low	
							// 2 = y direction high
							// 3 = y direction low
							// 4 = z direction high
							// 5 = z direction low
                				 

LOG_MODULE_REGISTER(MAIN, LOG_LEVEL_INF);

static void button_changed(uint32_t button_state, uint32_t has_changed)
{
	//printk("button_state = %d\n",button_state);
	//printk("has_changed = %d\n",has_changed);
	if ((has_changed & USER_BUTTON_1) && (button_state & USER_BUTTON_1)) 
	{
		printk("Button 1 down, printing current Confusion Matrix\n");
		printConfusionMatrix();
	}

	if ((has_changed & USER_BUTTON_2) && (button_state & USER_BUTTON_2)) 
	{
		printk("Button 2 down, resetting confusion matrix\n");
		resetConfusionMatrix();
		printConfusionMatrix();
	}		
	
	if ((has_changed & USER_BUTTON_3) && (button_state & USER_BUTTON_3)) 
	{
		printk("Button 3 down, making fake 100 meas or one real meas depending on DEBUG state\n");
		#if DEBUG
		direction = 0;
		makeHundredFakeClassifications();
		printConfusionMatrix();
		#else
        direction = (direction +1)%6;
		switch (direction)
		{
		case 0:
			printk("Direction is now set z = high\n");
			break;
		case 1:
			printk("Direction is now set z = low\n");
			break;
		case 2:
			printk("Direction is now set x = high\n");
			break;
		case 3:
			printk("Direction is now set x = low\n");
			break;
		case 4:
			printk("Direction is now set y = high\n");
			break;
		case 5:
			printk("Direction is now set y = low\n");
			break;
		
		default:
		    printk("Wrong direction set!!!\n");
			break;
		}

		struct Measurement m = readADCValue();
		printk("x = %d,  y = %d,  z = %d\n",m.x,m.y,m.z);
		#endif
	}		

	if ((has_changed & USER_BUTTON_4) && (button_state & USER_BUTTON_4)) 
	{
		printk("button 4 down, one meas and classification with current direction =%d\n",direction);
		struct Measurement m = readADCValue();
		printk("x = %d,  y = %d,  z = %d\n",m.x,m.y,m.z);
		makeOneClassificationAndUpdateConfusionMatrix(direction,m.x,m.y,m.z);
		
		printConfusionMatrix();
	}		
}


void main(void)
{
	int err;
	err = dk_leds_init();
	if (err) {
		LOG_ERR("LEDs init failed (err %d)\n", err);
		return;
	}

	err = dk_buttons_init(button_changed);
	if (err) {
		printk("Cannot init buttons (err: %d)\n", err);
		return;
	}
	
	
	if(initializeADC() != 0)
	{
	printk("ADC initialization failed!");
	return;
	}

	while (1) 
	{
		
		k_sleep(K_MSEC(1000));
		
		dk_set_led_on(USER_LED1);
		dk_set_led_on(USER_LED2);
		dk_set_led_on(USER_LED3);
		dk_set_led_on(USER_LED4);
		 
		k_sleep(K_MSEC(1000));
		
		dk_set_led_off(USER_LED1);
		dk_set_led_off(USER_LED2);
		dk_set_led_off(USER_LED3);
		dk_set_led_off(USER_LED4);


	}
}
```

## src/confusion.c
```c
#include <zephyr/kernel.h>
#include <math.h>
#include "confusion.h"
#include "adc.h"
#include "kmeans.h"
#include "neuroverkonKertoimet.h"
/* 
  K-means algorithm should provide 6 center points with
  3 values x,y,z. Let's test measurement system with known
  center points. I.e. x,y,z are supposed to have only values
  1 = down and 2 = up
  
  CP matrix is thus the 6 center points got from K-means algoritm
  teaching process. This should actually come from include file like
  #include "KmeansCenterPoints.h"
  
  And measurements matrix is just fake matrix for testing purpose
  actual measurements are taken from ADC when accelerator is connected.
*/ 

// tämä indeksoi k-means pisteet järjestykseen
int index_key[] = {5,0,1,3,4,2};


/*
int CP[6][3]={
	                     {1,0,0},
						 {2,0,0},
						 {0,1,0},
						 {0,2,0},
						 {0,0,1},
						 {0,0,2}
};
*/

int measurements[6][3]={
	                     {1,0,0},
						 {2,0,0},
						 {0,1,0},
						 {0,2,0},
						 {0,0,1},
						 {0,0,2}
};

int CM[6][6]= {0};
int CM_neuro[6][6] = {0};

float calculateDistance(int x1, int y1, int z1,
                        int x2, int y2, int z2){
   //kahden 3D-avaruuden pisteen välinen etäisyys on:
   //etäisyys = sqrt((x2-x1)**2+(y2-y1)**2+(z2-z1)**2)
   float x_delta = (float)x2 - (float)x1;
   float y_delta = (float)y2 - (float)y1;
   float z_delta = (float)z2 - (float)z1;

   float len = sqrt(pow(x_delta,2)+pow(y_delta,2)+pow(z_delta,2));

   return len;

}



void printConfusionMatrix(void)
{
	printk("Confusion matrix = \n");
	printk("   cp1 cp2 cp3 cp4 cp5 cp6\n");
	for(int i = 0;i<6;i++)
	{
		printk("cp%d %d   %d   %d   %d   %d   %d\n",i+1,CM[i][0],CM[i][1],CM[i][2],CM[i][3],CM[i][4],CM[i][5]);
	}

   printk("NEUROVERKON Confusion matrix = \n");
	printk("   cp1 cp2 cp3 cp4 cp5 cp6\n");
	for(int i = 0;i<6;i++)
	{
		printk("cp%d %d   %d   %d   %d   %d   %d\n",i+1,CM_neuro[i][0],CM_neuro[i][1],CM_neuro[i][2],CM_neuro[i][3],CM_neuro[i][4],CM_neuro[i][5]);
	}
}

void makeHundredFakeClassifications(void)
{
   /*******************************************
   Jos ja toivottavasti kun teet toteutuksen paloissa eli varmistat ensin,
   että etäisyyden laskenta 6 keskipisteeseen toimii ja osaat valita 6 etäisyydestä
   voittajaksi sen lyhyimmän etäisyyden, niin silloin voit käyttää tätä aliohjelmaa
   varmistaaksesi, että etäisuuden laskenta ja luokittelu toimii varmasti tunnetulla
   itse keksimälläsi sensoridatalla ja itse keksimilläsi keskipisteillä.
   *******************************************/

   //looppi joka tekee 100 kertaa tyhmän datapisteen suunnalla, arvaa tyhmän datapisteen winnerin
   //ja lopuksi confusion matrixiin koordinaattiin suunta,arvaussuunta lisätään yksi piste
   for (int i = 0; i<=99; i++){
      //arvotaan data
      int suunta = rand()%6;
      int x = rand()%2;
      int y = rand()%2;
      int z = rand()%2;

      makeOneClassificationAndUpdateConfusionMatrix(suunta,x,y,z);
   }


}

void makeOneClassificationAndUpdateConfusionMatrix(int direction,int x,int y,int z)
{
   /**************************************
   Tee toteutus tälle ja voit tietysti muuttaa tämän aliohjelman sellaiseksi,
   että se tekee esim 100 kpl mittauksia tai sitten niin, että tätä funktiota
   kutsutaan 100 kertaa yhden mittauksen ja sen luokittelun tekemiseksi.
   **************************************/

   int winner = calculateDistanceToAllCentrePointsAndSelectWinner(x,y,z);
   CM[direction][winner]++;

   
}

int calculateDistanceToAllCentrePointsAndSelectWinner(int x,int y,int z)
{
   /***************************************
   Tämän aliohjelma ottaa yhden kiihtyvyysanturin mittauksen x,y,z,
   laskee etäisyyden kaikkiin 6 K-means keskipisteisiin ja valitsee
   sen keskipisteen, jonka etäisyys mittaustulokseen on lyhyin.
   ***************************************/
  
   float minDistance = calculateDistance(x,y,z,CP[0][0],CP[0][1],CP[0][2]);
   float distance;
   int winner = 0;

   for (int i=0;i<6;i++){
      distance = calculateDistance(x,y,z,CP[index_key[i]][0],CP[index_key[i]][1],CP[index_key[i]][2]);
      if(minDistance >= distance){
         minDistance = distance;
         winner = i;
      }

   }
   return winner;
}

void resetConfusionMatrix(void)
{
	for(int i=0;i<6;i++)
	{ 
		for(int j = 0;j<6;j++)
		{
			CM[i][j]=0;
         CM_neuro[i][j]=0;
		}
	}
}

/* void softmax(float n2[6]){

   float sum = 0;

   for(int i=0;i<6;i++){
      sum += exp(n2[i]); //tässä ylivuodon eston kikkailu jota en ymmärrä
   }
   
   for(int i=0;i<6;i++){
      n2[i] = exp(n2[i])/ sum;
      //printk("%f\n", n2[i][0]);
   }
} */

void softmax(float n2[6]){
   //tämä on chatgpt koodia, jossa aiemman softmaxin yli-/alivuotobugi korjattu

   // Calculate softmax using log-sum-exp trick
   float maxVal = n2[0];
   for(int i = 1; i < 6; i++){
      if(n2[i] > maxVal) {
         maxVal = n2[i];
      }
   }

   float logSumExp = 0.0;
   for(int i = 0; i < 6; i++){
      logSumExp += exp(n2[i] - maxVal); //tässä kriittinen operaatio, - maxVal
   }

   float logSoftmax[6];
   for(int i = 0; i < 6; i++){
      logSoftmax[i] = n2[i] - maxVal - log(logSumExp);
   }

   // Exponentiate to get softmax probabilities
   for(int i = 0; i < 6; i++){
      n2[i] = exp(logSoftmax[i]);
   }
}

void relu(float n1[10]){
   

   for (int i=0;i<10;i++){
      if(n1[i] < 0){
         n1[i] = 0;
      }
      //printk("%f\n", n1[i][0]);
   }
}
void arraysum(float neuronit[], int r,float bias[r][1]){
   for(int i=0;i<r;i++){
      neuronit[i] += bias[i][0];
   }
}
/* void testi(){
   float valu[2][2] = {{1.1,2.2},{3.3,4.4}};
    arraytesti(valu);
   printk("{%f,%f}\n",valu[0][0],valu[0][1]);
   printk("{%f,%f}\n",valu[1][0],valu[1][1]);

   float n2[6][1] ={{-0.1601722240447998},{0.3263254761695862},{-0.16412590444087982},{0.1776800900697708},{0.03297794982790947},{0.18514344096183777}};

   softmax(n2);
   for(int i=0;i<6;i++){
      printk("%f\n", n2[i][0]);
   }

   float n1[10][1] = {{-5},{-4},{-3},{-2},{-1},{0},{1},{3},{4},{5}};

   relu(n1);
   for(int i=0;i<10;i++){
      printk("%f\n", n1[i][0]);
   }
   float jotain[] = {1.1,2.2,3.3};
   float jotain2[][1] = {{1.1},{2.2},{3.3}};

   arraysum(jotain,3,jotain2);
   for(int i=0;i<3;i++){
      printk("%f\n", jotain[i]);
   }

} */
void arraytesti(float arr[2][2]){
   arr[1][0] = 5.5;
   
}
   

float dotProduct(float x1, float y1, float z1,
                  float x2, float y2, float z2)
{
   float product = x2*x1 + y2*y1 + z2*z1;
   return product;
}

void matmul_l1(float w1[3][10], float a0[3], float tulos[10]){
   //w1 on muotoa [3][10]
   //a0 on siis oltava muotoa [1][3]
   //jokainen w1[3][rivi] pistetulotetaan a0 kanssa
   for(int i=0;i<10;i++){
      //tähän yhden rivin ja sarakkeen pistetulo

      float pistetulo = a0[0]*w1[0][i] + a0[1]*w1[1][i] + a0[2]*w1[2][i];
      tulos[i] = pistetulo;

   }
}


void matmul_l2(float w2[10][6], float a1[10], float tulos[6])
{
   //matriisikertolasku 10x6 * 1x10
   float pistetulo;
   for(int i=0;i<6;i++){
      for(int j=0;j<10;j++){
         pistetulo = pistetulo + w2[j][i]*a1[j];
      }
      tulos[i] = pistetulo;
      //printk("2. krs tulostaulukon %d:s elementti: %d\n",i+1,tulos[i]);
      pistetulo = 0;
   }

}

void neuroverkko(int dir, int x, int y, int z){
   float tulos1[] = {0,0,0,0,0,0,0,0,0,0};
   float a0[] = {x,y,z};
   printk("%f, %f, %f\n",a0[0],a0[1],a0[2]);
   float tulos2[] = {0,0,0,0,0,0};

   //Tässä lasketaan neuroverkon ensimmäinen hidden layer tulos1 matriisiin
   matmul_l1(str_w1,a0,tulos1);
   arraysum(tulos1,10,str_b1);
   relu(tulos1);

   for(int i=0;i<10;i++){
      printk("l1 tulosmatriisin %d. luku on %f\n",i+1,tulos1[i]);
      k_sleep(K_MSEC(10));
      //printk("l2 tulosmatriisin %d. luku on %f\n",i+1,tulos2[i]); 
   } 

   matmul_l2(str_w2,tulos1,tulos2);
   arraysum(tulos2,6,str_b2);
      for(int i=0;i<6;i++){
      printk("l2 tulosmatriisin %d. luku on %f\n",i+1,tulos2[i]);
      k_sleep(K_MSEC(10));
   } 
   softmax(tulos2);
   for(int i=0;i<6;i++){
      printk("l2 tulosmatriisin %d. luku on %f\n",i+1,tulos2[i]);
      k_sleep(K_MSEC(10));
   }


   float max = -__FLT_MAX__;
   int index = 0;
   for(int i=0;i<6;i++){
      if(tulos2[i]>= max){
         max = tulos2[i];
         index = i;
      }
   }
   CM_neuro[dir][index]++;
}
```

## src/confusion.h
```c
#ifndef CONFUSION_MATRIX_H
#define CONFUSION_MATRIX_H


void printConfusionMatrix(void);
void makeHundredFakeClassifications(void);
void makeOneClassificationAndUpdateConfusionMatrix(int,int,int,int);
int calculateDistanceToAllCentrePointsAndSelectWinner(int,int,int);
void resetConfusionMatrix(void);
float calculateDistance(int,int,int,int,int,int);
void softmax(float n2[6]);
void relu(float n1[10]);
void arraysum(float neuronit[], int r,float bias[r][1]);
void testi();
void arraytesti(float arr[2][2]);

float dotProduct(float,float,float,float,float,float);

void matmul_l1(float w1[3][10], float a0[3], float tulos[10]);
void matmul_l2(float w2[10][6], float a1[10], float tulos[6]);

void neuroverkko(int,int,int,int);
#endif
```

## src/neuroverkonKertoimet.h
```c
#ifndef NEUROVERKONKERTOIMET_H
#define NEUROVERKONKERTOIMET_H
float str_w1[3][10] = {{-0.24863605201244357,-0.2896242141723633,-0.2583872377872467,0.06261352449655533,0.5947365760803223,0.09853935241699217,-0.14325569570064545,0.3704269826412201,-0.23830583691596985,0.2164975106716156},
                        {0.1814446002244949,0.204010546207428,0.404493123292923,-0.07182198017835617,-0.2839376628398895,-0.2289299964904785,0.11062945425510406,-0.1838921010494232,-0.35112184286117554,0.04280062392354012},
                        {0.18216988444328308,-0.45886534452438354,-0.2124365270137787,0.5347311496734619,-0.5999540090560913,-0.37281090021133423,0.6007458567619324,0.038673102855682366,-0.6557939052581787,0.1722329407930374}};
float str_w2[10][6] = {{-0.14215016365051267,-0.3377755284309387,0.2541768550872803,0.6940651535987854,0.607430100440979,-0.05229433998465537},{-0.44864183664321894,-0.21492570638656616,-0.23771920800209043,0.1022179126739502,0.3741994500160217,0.2997957468032837},{0.41085201501846313,0.034416314214468,0.3445311188697815,-0.14978842437267303,0.019919170066714287,0.2530592978000641},{0.1113971397280693,0.5063754320144653,0.47894129157066345,0.34512802958488464,-0.4061613082885742,0.21856029331684113},{0.27457791566848755,0.4302765727043152,0.5161799788475037,0.4462272524833679,-0.4258512556552887,0.3904879689216614},{0.5102569460868835,-0.3392753005027771,0.04029405117034912,-0.17903369665145874,-0.5769073367118835,0.26811927556991577},{0.2564735412597656,-0.2638145685195923,-0.6826171278953552,-0.014781128615140913,-0.02099135518074036,0.1334688812494278},{0.3729596138000488,-0.2292024493217468,0.4679144620895386,-0.4509119093418121,0.21930600702762604,0.5251451730728148},{0.3453792929649353,-0.4506698250770569,0.2850572466850281,-0.2499202191829681,0.06424582004547119,-0.246911883354187},{-0.16347962617874143,0.41298556327819824,0.4211328029632568,-0.023395797237753868,0.667686939239502,-0.24227581918239596}};
float str_b1[10][1] = {{-0.09578638523817062},{0.0},{-0.22953076660633087},{0.01881483383476734},{0.0},{0.0},{0.0714053213596344},{-0.2699303328990936},{0.0},{-0.13507796823978424}};
float str_b2[6][1] = {{-0.1601722240447998},{0.3263254761695862},{-0.16412590444087982},{0.1776800900697708},{0.03297794982790947},{0.18514344096183777}};
#endif
```
